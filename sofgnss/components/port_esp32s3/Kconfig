## sofgnss/components/port_esp32s3/Kconfig
```kconfig
menu "sofgnss board (ESP32-S3)"

    comment "Defaults suit the Seeed Studio XIAO ESP32-S3"

    config SOFGNSS_PPS_GPIO
        int "PPS input GPIO"
        default 7
        help
            XIAO pin D8 (GPIO7), next to the RX pin.

    config SOFGNSS_PPS_RISING_EDGE
        bool "Capture PPS on the rising edge"
        default y

    config SOFGNSS_PPS_PULLDOWN
        bool "Enable internal pull-down on the PPS input"
        default n

    config SOFGNSS_GPS_UART_NUM
        int "UART peripheral for the GPS"
        range 1 2
        default 1

    config SOFGNSS_GPS_TX_GPIO
        int "GPS UART TX GPIO (to the receiver's RX)"
        default 43
        help
            XIAO pin D6, labelled TX.

    config SOFGNSS_GPS_RX_GPIO
        int "GPS UART RX GPIO (from the receiver's TX)"
        default 44
        help
            XIAO pin D7, labelled RX.

    config SOFGNSS_GPS_DEFAULT_BAUD
        int "GPS UART baud rate until the host sets one"
        default 38400

    config SOFGNSS_TICK_HZ
        int "Timestamp counter frequency (Hz)"
        default 80000000
        help
            MCPWM capture timer resolution. 80 MHz is the maximum on the ESP32-S3.

    config SOFGNSS_CAL_GPIO
        int "Calibration signal output GPIO"
        default 4
        help
            XIAO pin D3. Calibration bursts for an SDR. Connect through a series
            resistor, DC block and attenuators.

    config SOFGNSS_CAL_CS_GPIO
        int "Calibration burst-start loopback GPIO"
        default 5
        help
            XIAO pin D4. Used internally to timestamp each burst; needs no
            wiring. Low during a burst, so it works as a scope trigger.

    config SOFGNSS_LED_GPIO
        int "Status LED GPIO (-1 for none)"
        default 21
        help
            Shows PPS and GPS serial state (see README). The XIAO ESP32-S3 user
            LED is GPIO21, active low.

    config SOFGNSS_LED_ACTIVE_LOW
        bool "Status LED is active low"
        default y

    config SOFGNSS_USB_VID
        hex "USB vendor ID"
        default 0x20A0

    config SOFGNSS_USB_PID
        hex "USB product ID"
        default 0x4288

endmenu
```

## sofgps/components/port_esp32s3/Kconfig
```kconfig
menu "sofgps board (ESP32-S3)"

    comment "Defaults suit the Seeed Studio XIAO ESP32-S3"

    config SOFGPS_PPS_GPIO
        int "PPS input GPIO"
        default 7
        help
            XIAO pin D8 (GPIO7), next to the RX pin.

    config SOFGPS_PPS_RISING_EDGE
        bool "Capture PPS on the rising edge"
        default y

    config SOFGPS_PPS_PULLDOWN
        bool "Enable internal pull-down on the PPS input"
        default n

    config SOFGPS_GPS_UART_NUM
        int "UART peripheral for the GPS"
        range 1 2
        default 1

    config SOFGPS_GPS_TX_GPIO
        int "GPS UART TX GPIO (to the receiver's RX)"
        default 43
        help
            XIAO pin D6, labelled TX.

    config SOFGPS_GPS_RX_GPIO
        int "GPS UART RX GPIO (from the receiver's TX)"
        default 44
        help
            XIAO pin D7, labelled RX.

    config SOFGPS_GPS_DEFAULT_BAUD
        int "GPS UART baud rate until the host sets one"
        default 38400

    config SOFGPS_TICK_HZ
        int "Timestamp counter frequency (Hz)"
        default 80000000
        help
            MCPWM capture timer resolution. 80 MHz is the maximum on the ESP32-S3.

    config SOFGPS_CAL_GPIO
        int "Calibration signal output GPIO"
        default 4
        help
            XIAO pin D3. Calibration bursts for an SDR. Connect through a series
            resistor, DC block and attenuators.

    config SOFGPS_CAL_CS_GPIO
        int "Calibration burst-start loopback GPIO"
        default 5
        help
            XIAO pin D4. Used internally to timestamp each burst; needs no
            wiring. Low during a burst, so it works as a scope trigger.

    config SOFGPS_LED_GPIO
        int "Status LED GPIO (-1 for none)"
        default 21
        help
            Shows PPS and GPS serial state (see README). The XIAO ESP32-S3 user
            LED is GPIO21, active low.

    config SOFGPS_LED_ACTIVE_LOW
        bool "Status LED is active low"
        default y

    config SOFGPS_USB_VID
        hex "USB vendor ID"
        default 0x303A

    config SOFGPS_USB_PID
        hex "USB product ID"
        default 0x4001

endmenu
```

## sofgps/main/Kconfig.projbuild
```kconfig
menu "sofgps application"

    config SOFGPS_SOF_DIVIDER
        int "Default SOF divider (tag one frame in every N)"
        range 1 1000000
        default 100
        help
            100 gives ten tagged SOFs per second. Can be changed at runtime with
            $PVDB,SOFPPS,DIV,<n>*hh.

    config SOFGPS_SOF_DEBUG
        bool "Emit SOF spin diagnostics (SOFDBG sentences)"
        default n
        help
            Adds a $PVDB,SOFPPS,SOFDBG sentence with CPU cycle timings from the
            spin loop after every SOF sentence. For debugging jitter.

    config SOFGPS_SOF_DITHER
        bool "Dither which frame in each window is tagged"
        default y
        help
            Tag a pseudo-random frame in the first half of each window of N
            frames instead of always the first. This stops the capture rounding
            error from forming a slow sawtooth that a short fit can't average
            out.

    config SOFGPS_SOF_LEAD_US
        int "Wake the SOF spin this many microseconds before the predicted SOF"
        range 50 900
        default 200

    config SOFGPS_PPS_DCD
        bool "Mirror PPS on the CDC carrier-detect (DCD) line"
        default y
        help
            For LinuxPPS: "ldattach PPS /dev/ttyACMx" turns the DCD changes into
            /dev/ppsN. Only about 1 ms accurate; the exact time is in the PPS
            sentence.

    config SOFGPS_DCD_PULSE_MS
        int "Length of the DCD pulse per PPS (ms)"
        range 10 500
        default 100
        depends on SOFGPS_PPS_DCD

    config SOFGPS_HOST_WDT
        bool "Restart when the host has sent nothing for 60 s"
        default y
        help
            If the host sends no data for 60 s, the device restarts and
            re-enumerates. Control requests such as baud changes don't count.
            Host software should send $PVDB,SOFPPS,PING*hh at least once a minute.

    config SOFGPS_CAL
        bool "Calibration burst output for an SDR"
        default y
        help
            Noise or 2/20/40 MHz square-wave bursts (6.55 ms, one per PPS) on
            SOFGPS_CAL_GPIO for calibrating an SDR. Turn on at runtime with
            $PVDB,SOFPPS,CAL,<NOISE|SQ2|SQ20|SQ40|OFF>*hh. Each burst start is
            timestamped and reported in a CAL sentence.

    config SOFGPS_INFO_INTERVAL_S
        int "Seconds between $PVDB,SOFPPS,INFO sentences (0 disables)"
        default 1

    config SOFGPS_REQUIRE_DTR
        bool "Only send to the host while it asserts DTR"
        default n
        help
            Linux raises DTR when the port is opened and drops it on close.
            While DTR is low, GPS and timing messages are discarded instead of
            piling up, so a fresh open starts with live data. Disable for host
            software that never asserts DTR.

    config SOFGPS_OUTBOX_BYTES
        int "GPS->host message queue size (bytes)"
        default 12288
        help
            When full, the oldest whole messages are dropped.

    config SOFGPS_FRAME_TIMEOUT_MS
        int "Drop a partial GPS frame after this many ms without data"
        range 20 5000
        default 200
        help
            Otherwise a corrupted UBX/RTCM length could make the parser wait for
            kilobytes and swallow the messages that follow.

    config SOFGPS_FRAME_SLACK_MS
        int "Slack on a GPS frame's arrival time (ms)"
        range 20 2000
        default 100
        help
            A partial frame is dropped if it isn't complete within 1.25 times
            its expected wire time plus this slack. This catches false frame
            starts with a large length, and frames that trickle in too slowly to
            hit the idle timeout.

    config SOFGPS_PARSER_BYTES
        int "Largest GPS frame accepted (bytes)"
        range 1029 65535
        default 4096
        help
            Largest UBX frame passed to the host; larger ones are skipped and
            counted in parse_errors. The minimum is the largest RTCM3 frame.
            Must be below SOFGPS_OUTBOX_BYTES. The default fits a UBX-RXM-RAWX
            with 127 measurements.

endmenu
```
